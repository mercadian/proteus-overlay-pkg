/*
 * Copyright (C) 2022 Mercadian Systems LLC
 */
 
/dts-v1/;
/plugin/;

// Overwrites the GPIO pin used for the STA (user) LED and the default trigger.
/{
	fragment@0 {
		target = <&sta_led>;
		__overlay__ {
			gpios = <&gpio1 13 0>; // 13 here corresponds to GPIO pin 26
			linux,default-trigger = "activity";
		};
	};

	fragment@1 {
		target = <&hdmirx_ctrler>;
		__overlay__ {
			status = "disabled";
			hdmirx-det-gpios = <&gpio2 26 1>; // Swap PB5 (pin 26) with PD2 (no GPIO pin)
		};
	};
};